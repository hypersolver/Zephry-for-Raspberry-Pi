## CMakeLists.txt
```
cmake_minimum_required(VERSION 3.20.0)

find_package(Zephyr REQUIRED HINTS $ENV{ZEPHYR_BASE})
project(rpiduino_zavira LANGUAGES C CXX)

if(NOT CONFIG_BOARD_RPI_4B AND NOT CONFIG_BOARD_QEMU_CORTEX_A53)
  message(FATAL_ERROR "Select rpi_4b or qemu_cortex_a53")
endif()

include(FetchContent)
FetchContent_Declare(zavira
  GIT_REPOSITORY https://github.com/hypersolver/zavira-gui.git
  GIT_TAG 6f89905e562c661b2ae0b5f36d9a04da5b389b34)
FetchContent_MakeAvailable(zavira)

target_include_directories(app PRIVATE include ${zavira_SOURCE_DIR}/include)
target_compile_definitions(app PRIVATE RPIDUINO_ZAPP_DESKTOP RPIDUINO_UART_CONTROL)
target_sources(app PRIVATE
  src/main.cpp src/heartbeat.cpp src/uart_control.cpp src/zapp_loader.c src/zapp_input.c)
if(CONFIG_BOARD_RPI_4B)
  target_sources(app PRIVATE src/reboot.c)
endif()

add_llext_target(zavira_desktop OUTPUT ${PROJECT_BINARY_DIR}/desktop.zapp
  SOURCES ${zavira_SOURCE_DIR}/zapps/desktop.c)
add_llext_target(zavira_demo OUTPUT ${PROJECT_BINARY_DIR}/lvgl-demo.zapp
  SOURCES ${zavira_SOURCE_DIR}/zapps/lvgl_demo.c)

add_llext_target(zavira_benchmark OUTPUT ${PROJECT_BINARY_DIR}/lvgl-benchmark.zapp
  SOURCES ${zavira_SOURCE_DIR}/zapps/lvgl_benchmark.c)

# Zephyr 4.5 orders the packaging step after the link without tracking the linked file.
foreach(extension IN ITEMS zavira_desktop zavira_demo zavira_benchmark)
  add_custom_command(OUTPUT ${PROJECT_BINARY_DIR}/llext/${extension}_debug.elf
    APPEND DEPENDS $<TARGET_FILE:${extension}_llext_lib>)
endforeach()
add_custom_target(rpiduino_zapps ALL
  DEPENDS ${PROJECT_BINARY_DIR}/desktop.zapp ${PROJECT_BINARY_DIR}/lvgl-demo.zapp
          ${PROJECT_BINARY_DIR}/lvgl-benchmark.zapp)
```

## prj.conf
```kconfig
CONFIG_CPP=y
CONFIG_SERIAL=y
CONFIG_CONSOLE=y
CONFIG_UART_CONSOLE=y
CONFIG_PRINTK=y
CONFIG_TIMEOUT_64BIT=y
CONFIG_DISPLAY=y
CONFIG_LVGL=y
CONFIG_LV_USE_LABEL=y
CONFIG_LV_FONT_MONTSERRAT_28=y
CONFIG_LV_Z_MEM_POOL_SIZE=32768
CONFIG_LV_Z_VDB_SIZE=10
CONFIG_LLEXT=y
CONFIG_LLEXT_TYPE_ELF_RELOCATABLE=y
CONFIG_LLEXT_HEAP_SIZE=128
CONFIG_CRC=y
CONFIG_REBOOT=y
```

## boards/rpi_4b.overlay
```dts
/* SPDX-License-Identifier: Apache-2.0 */
&{/soc} {
	power: power-controller@fe100000 {
		reg = <0xfe100000 0x1000>;
	};
};
```

## src/main.cpp
```c
#include <rpiduino/sketch.hpp>

int main()
{
    setup();
    for (;;) {
        loop();
    }
}
```

## src/heartbeat.cpp
```c
#include <rpiduino/sketch.hpp>
#include <zephyr/sys/printk.h>
#ifdef RPIDUINO_UART_CONTROL
#include <rpiduino/uart_control.hpp>
#endif

void setup()
{
    printk("RPiduino Zephyr: setup complete\n");
}

void loop()
{
    printk("RPiduino Zephyr: uptime=%u ms\n", static_cast<unsigned int>(millis()));
#ifdef RPIDUINO_UART_CONTROL
    const uint32_t start = millis();
    do {
        pollUartControl();
        k_sleep(K_TICKS(1));
    } while (millis() - start < 1000);
#else
    delay(1000);
#endif
}
```

## src/reboot.c
```c
/* SPDX-License-Identifier: Apache-2.0 */
#include <zephyr/arch/cpu.h>
#include <zephyr/devicetree.h>
#include <zephyr/init.h>
#include <zephyr/sys/barrier.h>
#include <zephyr/sys/device_mmio.h>
#include <zephyr/sys/sys_io.h>
#include <zephyr/sys/util.h>

#define PM_NODE DT_NODELABEL(power)
#define PM_RSTC 0x1cU
#define PM_WDOG 0x24U
#define PM_PASSWORD 0x5a000000U
#define PM_CONTROL_MASK GENMASK(23, 0)
#define PM_RESET_MODE_MASK GENMASK(5, 4)
#define PM_FULL_RESET BIT(5)
#define PM_RESET_DELAY_TICKS 10U

#ifdef CONFIG_SOC_BCM2711
static mm_reg_t pm_base;

static int map_power_controller(void)
{
	device_map(&pm_base, DT_REG_ADDR(PM_NODE), DT_REG_SIZE(PM_NODE), K_MEM_CACHE_NONE);
	return 0;
}

SYS_INIT(map_power_controller, PRE_KERNEL_1, 0);
#else
static const uintptr_t pm_base = DT_REG_ADDR(PM_NODE);
#endif

void sys_arch_reboot(int type)
{
	ARG_UNUSED(type);

	const uint32_t control = sys_read32(pm_base + PM_RSTC) & PM_CONTROL_MASK;

	sys_write32(PM_PASSWORD | PM_RESET_DELAY_TICKS, pm_base + PM_WDOG);
	sys_write32(PM_PASSWORD | (control & ~PM_RESET_MODE_MASK) | PM_FULL_RESET,
		    pm_base + PM_RSTC);
	barrier_dsync_fence_full();

	/* Keep the CPU here until the watchdog resets the SoC. */
	for (;;) {
		__asm__ volatile("wfe");
	}
}
```

## src/uart_control.cpp
```c
#include <rpiduino/uart_control.hpp>
#include <rpiduino/sketch.hpp>
#include <string.h>
#include <zephyr/device.h>
#include <zephyr/devicetree.h>
#include <zephyr/drivers/uart.h>
#include <zephyr/sys/printk.h>
#include <zephyr/sys/reboot.h>
#ifdef RPIDUINO_ZAPP_DESKTOP
#include <rpiduino/zapp.h>
#include <rpiduino/zapp_input.h>
#endif

namespace {
const device *const console = DEVICE_DT_GET(DT_CHOSEN(zephyr_console));
char line[32];
size_t length;
bool overflow;
unsigned char received;
}

[[noreturn]] void rebootFromUart()
{
    printk("@RPIDUINO RESETTING\n");
    // Let the UART finish transmitting before resetting its clock.
    delay(50);
    sys_reboot(SYS_REBOOT_COLD);
}

void pollUartControl()
{
    while (uart_poll_in(console, &received) == 0) {
        if (received == '\n') {
            if (!overflow) {
                line[length] = '\0';
                if (strcmp(line, "@RPIDUINO RESET") == 0) {
                    rebootFromUart();
                } else if (strcmp(line, "@RPIDUINO PING") == 0) {
                    printk("@RPIDUINO READY 1\n");
                } else if (strcmp(line, "@RPIDUINO DEBUG") == 0) {
                    printk("@RPIDUINO DEBUG board=%s uptime_ms=%u img=unsupported\n",
                           CONFIG_BOARD_TARGET, static_cast<unsigned int>(millis()));
#ifdef RPIDUINO_ZAPP_DESKTOP
                } else if (strcmp(line, "@RPIDUINO OPEN LVGL") == 0) {
                    zapp_request(ZAPP_DEMO);
                    printk("@RPIDUINO QUEUED\n");
                } else if (strcmp(line, "@RPIDUINO OPEN BENCH") == 0) {
                    zapp_request(ZAPP_BENCHMARK);
                    printk("@RPIDUINO QUEUED\n");
                } else if (strncmp(line, "@RPIDUINO MOUSE ", 16) == 0 ||
                           strncmp(line, "@RPIDUINO KEY ", 14) == 0) {
                    if (!zapp_input_command(line + 10)) {
                        printk("@RPIDUINO ERROR INPUT\n");
                    }
                } else if (strcmp(line, "@RPIDUINO DESKTOP") == 0) {
                    zapp_request(ZAPP_DESKTOP);
                    printk("@RPIDUINO QUEUED\n");
#endif
                }
            }
            length = 0;
            overflow = false;
        } else if (received != '\r') {
            if (length < sizeof(line) - 1 && received >= 32 && received <= 126) {
                line[length++] = static_cast<char>(received);
            } else {
                overflow = true;
            }
        }
    }
}
```

## src/zapp_input.c
```c
/* SPDX-License-Identifier: Apache-2.0 */
#include <lvgl.h>
#include <string.h>
#include <rpiduino/zapp.h>
#include <rpiduino/zapp_input.h>
#include <zephyr/kernel.h>
#include <zephyr/sys/atomic.h>

struct pointer_event {
	uint16_t x;
	uint16_t y;
	bool pressed;
};

K_MSGQ_DEFINE(pointer_events, sizeof(struct pointer_event), 16, 4);
K_MSGQ_DEFINE(keys, sizeof(uint32_t), 8, 4);
static lv_group_t *group;
static lv_obj_t *cursor;
static struct pointer_event pointer = {320, 240, false};

static int coordinate(const char *digits)
{
	int value = 0;

	for (int i = 0; i < 3; i++) {
		if (digits[i] < '0' || digits[i] > '9') {
			return -1;
		}
		value = value * 10 + digits[i] - '0';
	}
	return value;
}

bool zapp_input_command(const char *command)
{
	if (strlen(command) == 15 && strncmp(command, "MOUSE ", 6) == 0 &&
	    command[9] == ' ' && command[13] == ' ' &&
	    (command[14] == '0' || command[14] == '1')) {
		int x = coordinate(command + 6);
		int y = coordinate(command + 10);

		if (x >= 0 && x < 640 && y >= 0 && y < 480) {
			struct pointer_event event = {x, y, command[14] == '1'};
			return k_msgq_put(&pointer_events, &event, K_NO_WAIT) == 0;
		}
	}

	static const struct {
		const char *command;
		uint32_t key;
	} mapping[] = {{"KEY NEXT", LV_KEY_NEXT}, {"KEY PREV", LV_KEY_PREV},
		       {"KEY ENTER", LV_KEY_ENTER}};
	for (size_t i = 0; i < ARRAY_SIZE(mapping); i++) {
		if (strcmp(command, mapping[i].command) == 0) {
			return k_msgq_put(&keys, &mapping[i].key, K_NO_WAIT) == 0;
		}
	}
	if (strcmp(command, "KEY ESC") == 0) {
		zapp_request(ZAPP_DESKTOP);
		return true;
	}
	return false;
}

static void pointer_read(lv_indev_t *indev, lv_indev_data_t *data)
{
	ARG_UNUSED(indev);
	if (k_msgq_get(&pointer_events, &pointer, K_NO_WAIT) == 0) {
		lv_obj_set_hidden(cursor, false);
	}
	data->point.x = pointer.x;
	data->point.y = pointer.y;
	data->state = pointer.pressed ? LV_INDEV_STATE_PRESSED : LV_INDEV_STATE_RELEASED;
	data->continue_reading = k_msgq_num_used_get(&pointer_events) != 0;
}

static void keyboard_read(lv_indev_t *indev, lv_indev_data_t *data)
{
	ARG_UNUSED(indev);
	static uint32_t key;
	static bool pressed;

	if (pressed) {
		pressed = false;
	} else {
		pressed = k_msgq_get(&keys, &key, K_NO_WAIT) == 0;
	}
	data->key = key;
	data->state = pressed ? LV_INDEV_STATE_PRESSED : LV_INDEV_STATE_RELEASED;
	data->continue_reading = pressed || k_msgq_num_used_get(&keys) != 0;
}

void zapp_input_add_button(void *object)
{
	if (group) {
		lv_group_add_obj(group, object);
	}
}

void zapp_input_init(void)
{
	group = lv_group_create();
	lv_indev_t *keypad = lv_indev_create();
	lv_indev_set_type(keypad, LV_INDEV_TYPE_KEYPAD);
	lv_indev_set_group(keypad, group);
	lv_indev_set_read_cb(keypad, keyboard_read);

	cursor = lv_obj_create(lv_layer_top());
	lv_obj_remove_style_all(cursor);
	lv_obj_set_size(cursor, 9, 9);
	lv_obj_remove_flag(cursor, LV_OBJ_FLAG_CLICKABLE | LV_OBJ_FLAG_SCROLLABLE);
	lv_obj_set_style_bg_color(cursor, lv_color_hex(0xf5efff), 0);
	lv_obj_set_style_bg_opa(cursor, LV_OPA_COVER, 0);
	lv_obj_set_style_border_color(cursor, lv_color_hex(0x332167), 0);
	lv_obj_set_style_border_width(cursor, 1, 0);
	lv_obj_set_hidden(cursor, true);
	lv_indev_t *mouse = lv_indev_create();
	lv_indev_set_type(mouse, LV_INDEV_TYPE_POINTER);
	lv_indev_set_read_cb(mouse, pointer_read);
	lv_indev_set_cursor(mouse, cursor);
}
```

## src/zapp_loader.c
```c
/* SPDX-License-Identifier: Apache-2.0 */
#include <errno.h>
#include <lvgl.h>
#include <string.h>
#include <rpiduino/zapp.h>
#include <rpiduino/zapp_input.h>
#include <zephyr/device.h>
#include <zephyr/drivers/display.h>
#include <zephyr/kernel.h>
#include <zephyr/llext/buf_loader.h>
#include <zephyr/llext/llext.h>
#include <zephyr/sys/atomic.h>
#include <zephyr/sys/byteorder.h>
#include <zephyr/sys/crc.h>
#include <zephyr/sys/device_mmio.h>
#include <zephyr/sys/printk.h>
#include <zephyr/version.h>

#define BUNDLE_ADDRESS (IS_ENABLED(CONFIG_BOARD_RPI_4B) ? 0x02000000U : 0x47000000U)
#define BUNDLE_CAPACITY (128U * 1024U)

struct zapp {
	const char *name;
	const uint8_t *data;
	size_t size;
	struct llext *extension;
	void (*render)(const struct zapp_ui *, enum zapp_page);
	void (*tick)(uint32_t);
};

static struct zapp desktop = {.name = "desktop"};
static struct zapp demo = {.name = "lvgl-demo"};
static struct zapp benchmark = {.name = "lvgl-benchmark"};
static atomic_t pending_page;
static uint32_t redraws;

void zapp_request(enum zapp_page page)
{
	if (page >= ZAPP_DESKTOP && page <= ZAPP_BENCHMARK) {
		atomic_set(&pending_page, page);
	}
}

static void scene(uint32_t color)
{
	lv_obj_t *screen = lv_screen_active();

	lv_obj_clean(screen);
	lv_obj_set_style_bg_color(screen, lv_color_hex(color), 0);
	lv_obj_set_style_bg_opa(screen, LV_OPA_COVER, 0);
}

static void panel(int x, int y, int width, int height, uint32_t color)
{
	lv_obj_t *object = lv_obj_create(lv_screen_active());

	lv_obj_remove_style_all(object);
	lv_obj_remove_flag(object, LV_OBJ_FLAG_SCROLLABLE);
	lv_obj_set_pos(object, x, y);
	lv_obj_set_size(object, width, height);
	lv_obj_set_style_bg_color(object, lv_color_hex(color), 0);
	lv_obj_set_style_bg_opa(object, LV_OPA_COVER, 0);
}

static void *label(int x, int y, const char *text, uint32_t color, int large)
{
	lv_obj_t *object = lv_label_create(lv_screen_active());

	lv_obj_set_pos(object, x, y);
	lv_obj_set_style_text_color(object, lv_color_hex(color), 0);
	if (large) {
		lv_obj_set_style_text_font(object, &lv_font_montserrat_28, 0);
	}
	lv_label_set_text(object, text);
	return object;
}

static void set_text(void *object, const char *text)
{
	lv_label_set_text(object, text);
}

static void open_button(lv_event_t *event)
{
	zapp_request((enum zapp_page)(uintptr_t)lv_event_get_user_data(event));
}

static void button(int x, int y, int width, int height, const char *text,
		   uint32_t color, enum zapp_page destination)
{
	lv_obj_t *object = lv_button_create(lv_screen_active());
	lv_obj_t *caption = lv_label_create(object);

	lv_obj_set_pos(object, x, y);
	lv_obj_set_size(object, width, height);
	lv_obj_set_style_radius(object, 0, 0);
	lv_obj_set_style_bg_color(object, lv_color_hex(color), 0);
	lv_obj_set_style_text_color(caption, lv_color_hex(0xffffff), 0);
	lv_label_set_text(caption, text);
	lv_obj_center(caption);
	lv_obj_add_event_cb(object, open_button, LV_EVENT_CLICKED, (void *)(uintptr_t)destination);
	zapp_input_add_button(object);
}

static void *bar(int x, int y, int width, int height, uint32_t color)
{
	lv_obj_t *object = lv_bar_create(lv_screen_active());

	lv_obj_set_pos(object, x, y);
	lv_obj_set_size(object, width, height);
	lv_obj_set_style_bg_color(object, lv_color_hex(color), LV_PART_INDICATOR);
	return object;
}

static void set_bar(void *object, unsigned int percent)
{
	lv_bar_set_value(object, (int32_t)percent, LV_ANIM_OFF);
}

struct triangle {
	lv_color_t color;
	struct zapp_point points[3];
};

static void draw_triangle(lv_event_t *event)
{
	struct triangle *shape = lv_event_get_user_data(event);
	lv_draw_triangle_dsc_t draw;
	lv_area_t bounds;

	lv_obj_get_coords(lv_event_get_target_obj(event), &bounds);
	lv_draw_triangle_dsc_init(&draw);
	draw.color = shape->color;
	for (size_t i = 0; i < ARRAY_SIZE(shape->points); i++) {
		draw.p[i].x = bounds.x1 + shape->points[i].x;
		draw.p[i].y = bounds.y1 + shape->points[i].y;
	}
	lv_draw_triangle(lv_event_get_layer(event), &draw);
}

static void free_triangle(lv_event_t *event)
{
	lv_free(lv_event_get_user_data(event));
}

static void *triangle(int x, int y, int size, uint32_t color)
{
	struct triangle *shape = lv_malloc_zeroed(sizeof(*shape));
	if (!shape) {
		return NULL;
	}

	lv_obj_t *object = lv_obj_create(lv_screen_active());
	lv_obj_remove_style_all(object);
	lv_obj_remove_flag(object, LV_OBJ_FLAG_SCROLLABLE | LV_OBJ_FLAG_CLICKABLE);
	lv_obj_set_pos(object, x, y);
	lv_obj_set_size(object, size, size);
	shape->color = lv_color_hex(color);
	lv_obj_add_event_cb(object, draw_triangle, LV_EVENT_DRAW_MAIN, shape);
	lv_obj_add_event_cb(object, free_triangle, LV_EVENT_DELETE, shape);
	lv_obj_set_user_data(object, shape);
	return object;
}

static void set_triangle(void *object, const struct zapp_point points[3])
{
	if (object) {
		struct triangle *shape = lv_obj_get_user_data(object);
		memcpy(shape->points, points, sizeof(shape->points));
		lv_obj_invalidate(object);
	}
}

static void redraw_complete(lv_event_t *event)
{
	ARG_UNUSED(event);
	redraws++;
}

static uint32_t redraw_count(void)
{
	return redraws;
}

static void report_benchmark(uint32_t count, uint32_t elapsed_ms)
{
	printk("RPiduino BENCH: redraws=%u elapsed_ms=%u\n", count, elapsed_ms);
}

static const struct zapp_ui ui = {
	.version = KERNEL_VERSION_STRING, .scene = scene, .panel = panel, .label = label,
	.set_text = set_text, .button = button, .bar = bar, .set_bar = set_bar,
	.triangle = triangle, .set_triangle = set_triangle,
	.redraw_count = redraw_count, .report_benchmark = report_benchmark,
};

static int locate_zapps(void)
{
	mm_reg_t mapped;

	device_map(&mapped, BUNDLE_ADDRESS, BUNDLE_CAPACITY, K_MEM_CACHE_WB);
	const uint8_t *bundle = (const uint8_t *)(uintptr_t)mapped;
	uint32_t version = sys_get_le32(bundle + 4);
	if (memcmp(bundle, "ZAPP", 4) != 0 || version < 1 || version > 3) {
		return -ENOENT;
	}

	struct zapp *slots[] = {&desktop, &demo, &benchmark};
	size_t count = version == 3 ? ARRAY_SIZE(slots) : 2;
	size_t offset = 8 + count * 8;
	for (size_t i = 0; i < count; i++) {
		size_t size = sys_get_le32(bundle + 8 + i * 8);
		uint32_t expected = sys_get_le32(bundle + 12 + i * 8);

		if (size < 64 || size > BUNDLE_CAPACITY - offset ||
		    crc32_ieee(bundle + offset, size) != expected) {
			return -EBADMSG;
		}
		slots[i]->size = size;
		slots[i]->data = bundle + offset;
		offset += ROUND_UP(size, 8);
	}
	return 0;
}

static int load_zapp(struct zapp *app)
{
	if (app->extension) {
		return 0;
	}
	if (!app->data) {
		return -ENOENT;
	}
	struct llext_buf_loader loader = LLEXT_TEMPORARY_BUF_LOADER(app->data, app->size);
	struct llext_load_param parameters = LLEXT_LOAD_PARAM_DEFAULT;
	int result = llext_load(&loader.loader, app->name, &app->extension, &parameters);
	if (result < 0) {
		return result;
	}
	app->render = llext_find_sym(&app->extension->exp_tab, "zapp_render");
	app->tick = llext_find_sym(&app->extension->exp_tab, "zapp_tick");
	if (!app->render || !app->tick) {
		llext_unload(&app->extension);
		return -ENOEXEC;
	}
	return 0;
}

static void gui(void *one, void *two, void *three)
{
	ARG_UNUSED(one);
	ARG_UNUSED(two);
	ARG_UNUSED(three);
	const struct device *display = DEVICE_DT_GET(DT_CHOSEN(zephyr_display));

	if (!device_is_ready(display) || !lv_display_get_default()) {
		printk("RPiduino HDMI: framebuffer unavailable\n");
		return;
	}
	int result = locate_zapps();
	if (result == 0) {
		result = load_zapp(&desktop);
	}
	if (result < 0) {
		printk("RPiduino ZAPP: desktop load failed (%d)\n", result);
		return;
	}
	result = display_blanking_off(display);
	if (result < 0 && result != -ENOSYS) {
		printk("RPiduino HDMI: unblank failed (%d)\n", result);
		return;
	}
	zapp_input_init();
	lv_display_add_event_cb(lv_display_get_default(), redraw_complete, LV_EVENT_RENDER_READY,
				NULL);

	desktop.render(&ui, ZAPP_SPLASH);
	printk("RPiduino ZAPP: splash\n");
	int64_t splash_until = k_uptime_get() + 2000;
	struct zapp *active = &desktop;
	for (;;) {
		const int64_t now = k_uptime_get();
		if (splash_until && now >= splash_until) {
			splash_until = 0;
			desktop.render(&ui, ZAPP_DESKTOP);
			printk("RPiduino ZAPP: desktop ready\n");
		}
		if (!splash_until) {
			enum zapp_page page = atomic_set(&pending_page, 0);
			if (page >= ZAPP_DESKTOP && page <= ZAPP_BENCHMARK) {
				struct zapp *apps[] = {&desktop, &demo, &benchmark};
				struct zapp *next = apps[page - ZAPP_DESKTOP];

				result = load_zapp(next);
				if (result < 0) {
					printk("RPiduino ZAPP: %s load failed (%d)\n", next->name, result);
				} else {
					active = next;
					active->render(&ui, page);
					printk("RPiduino ZAPP: opened %s\n", active->name);
				}
			}
		}
		active->tick((uint32_t)now);
		lv_timer_handler();
		k_sleep(K_MSEC(20));
	}
}

K_THREAD_DEFINE(zapp_gui, 8192, gui, NULL, NULL, NULL, 5, 0, 0);
```
