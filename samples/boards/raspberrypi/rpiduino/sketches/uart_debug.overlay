/* SPDX-License-Identifier: Apache-2.0 */
&{/soc} {
	sdhost: mmc@3f202000 {
		compatible = "brcm,bcm2835-sdhost";
		reg = <0x3f202000 0x100>;
		clock-frequency = <250000000>;
		bus-width = <4>;

		sdmmc {
			compatible = "zephyr,sdmmc-disk";
			disk-name = "SD";
		};
	};
};
