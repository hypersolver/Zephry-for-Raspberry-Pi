## samples/boards/raspberrypi/rpiduino/boards/raspberrypi/rpi_3/board.yml
```yaml
board:
  name: rpi_3
  full_name: Raspberry Pi 3 Model B and Model B+
  vendor: raspberrypi
  socs:
    - name: bcm2837
```

## samples/boards/raspberrypi/rpiduino/boards/raspberrypi/rpi_3/rpi_3_defconfig
```kconfig
CONFIG_XIP=n
CONFIG_SMP=n
CONFIG_BUILD_OUTPUT_BIN=y
CONFIG_UART_INTERRUPT_DRIVEN=n
CONFIG_TIMER_READS_ITS_FREQUENCY_AT_RUNTIME=y
CONFIG_REBOOT=y
CONFIG_SYS_CLOCK_TICKS_PER_SEC=1000
```

## samples/boards/raspberrypi/rpiduino/soc/brcm/bcm2837/Kconfig
```kconfig
# SPDX-License-Identifier: Apache-2.0
config SOC_BCM2837
	select ARM64
	select CPU_CORTEX_A53
	select ARM_CUSTOM_INTERRUPT_CONTROLLER
	select SERIAL_HAS_DRIVER if SERIAL
	select SDHC_SUPPORTS_NATIVE_MODE if SDHC && DT_HAS_BRCM_BCM2835_SDHOST_ENABLED
```
